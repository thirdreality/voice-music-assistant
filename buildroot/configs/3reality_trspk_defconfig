## buildroot/configs/3reality_trspk_defconfig
```kconfig
#--------------------------------------------------------#
# arch_a64_10.2_10.2.config
BR2_aarch64=y
BR2_TOOLCHAIN_EXTERNAL=y
BR2_TOOLCHAIN_EXTERNAL_CUSTOM=y
BR2_TOOLCHAIN_EXTERNAL_PATH="$(TOPDIR)/../sources/toolchain/gcc-arm-10.2-2020.11-x86_64-aarch64-none-linux-gnu"
BR2_TOOLCHAIN_EXTERNAL_GLIBC=y
BR2_TOOLCHAIN_EXTERNAL_CUSTOM_GLIBC=y
BR2_TOOLCHAIN_EXTERNAL_CXX=y
BR2_TOOLCHAIN_EXTERNAL_HEADERS_4_20=y
BR2_TOOLCHAIN_EXTERNAL_PREFIX="aarch64-none-linux-gnu"
BR2_TOOLCHAIN_EXTERNAL_CUSTOM_PREFIX="aarch64-none-linux-gnu"
BR2_TOOLCHAIN_EXTERNAL_INET_RPC=y
BR2_KERNEL_TOOLCHAIN_PATH="$(TOPDIR)/../sources/toolchain/gcc-arm-10.2-2020.11-x86_64-aarch64-none-linux-gnu"
BR2_KERNEL_TOOLCHAIN_LINARO_AARCH64_202011=y


# a113_s420_k54.config
BR2_TARGET_UBOOT_BOARDNAME="axg_s420_v1_trspk"
BR2_LINUX_KERNEL_INTREE_DTS_NAME="axg_s420_v03trspk"
BR2_ROOTFS_OVERLAY="board/thirdreality/trspk/rootfs/"
#BR2_ROOTFS_UPGRADE_DIR_OVERLAY="?"
BR2_ROOTFS_POST_BUILD_SCRIPT="$(TOPDIR)/board/thirdreality/trspk/post_build.sh"
BR2_SYSTEM_DHCP="wlan0"
BR2_PACKAGE_AML_SOC_BOARD_NAME="S420"


# base_aml.config
BR2_BACKUP_SITE="http://sources.buildroot.net"
BR2_DEPRECATED=y
BR2_TARGET_USBTOOL_AMLOGIC=y
BR2_PACKAGE_AML_UTIL=y
BR2_PACKAGE_AML_BOOTLOADER_MESSAGE=y
BR2_PACKAGE_AML_UBOOTENV=y
BR2_PACKAGE_UTIL_LINUX_BINARIES=y
BR2_PACKAGE_BUSYBOX_SHOW_OTHERS=y
BR2_TARGET_GENERIC_ROOT_PASSWD="hello3r"


# a113_base_k54.config
BR2_cortex_a9=y
BR2_ARM_ENABLE_VFP=y
BR2_ARM_ENABLE_NEON=y
BR2_ARM_FPU_NEON=y
BR2_LINUX_KERNEL=y
BR2_LINUX_KERNEL_CUSTOM_LOCAL_VERSION_VALUE="amlogic-5.4-dev"
BR2_LINUX_KERNEL_CUSTOM_LOCAL=y
BR2_LINUX_KERNEL_CUSTOM_LOCAL_PATH="$(TOPDIR)/../sources/kernel"
BR2_LINUX_KERNEL_DEFCONFIG="meson64_a64_smarthome"
BR2_LINUX_KERNEL_IMAGE_LOADADDR="0x1008000"
BR2_LINUX_KERNEL_PATCH="amlogic-5.4"
BR2_LINUX_KERNEL_DTS_SUPPORT=y
BR2_LINUX_KERNEL_USE_INTREE_DTS=y
BR2_LINUX_KERNEL_AMLOGIC_DTD=y
BR2_LINUX_KERNEL_ANDROID_FORMAT=y
BR2_LINUX_KERNEL_IMAGE=y
BR2_TARGET_BOARD_PLATFORM="mesonaxg"
BR2_TARGET_UBOOT=y
BR2_TARGET_UBOOT_CUSTOM_LOCAL=y
BR2_TARGET_UBOOT_CUSTOM_LOCAL_VERSION_VALUE="next-2015-dev"
BR2_TARGET_UBOOT_CUSTOM_LOCAL_LOCATION="$(TOPDIR)/../sources/uboot"
BR2_TARGET_UBOOT_PATCH=""
BR2_TARGET_UBOOT_AMLOGIC_REPO=y
BR2_TARGET_UBOOT_PLATFORM="axg"
BR2_ROOTFS_COMMON_OVERLAY="board/thirdreality/common/rootfs/"
BR2_ROOTFS_UPGRADE_DIR="board/thirdreality/common/upgrade/"
BR2_RECOVERY_OTA_DIR="board/thirdreality/common/ota/ota-axg/"
BR2_RECOVERY_OTA_RAMDISK_DIR="board/thirdreality/common/ota/ota-axg/ramdisk/"
BR2_TARGET_ROOTFS_CPIO=y
BR2_TARGET_ROOTFS_CPIO_GZIP=y
BR2_TARGET_ROOTFS_CPIO_UIMAGE=y
BR2_TARGET_ROOTFS_TAR_GZIP=y
BR2_ROOTFS_DEVICE_CREATION_DYNAMIC_MDEV=y
BR2_PACKAGE_AML_SOC_FAMILY_NAME="AXG"
BR2_PACKAGE_AML_SOC_CHIP_NAME="A113"


# alsa.config
BR2_PACKAGE_ALSA_LIB=y
BR2_PACKAGE_ALSA_LIB_DEVDIR="/dev/snd"
BR2_PACKAGE_ALSA_LIB_PCM_PLUGINS="all"
BR2_PACKAGE_ALSA_LIB_CTL_PLUGINS="all"
BR2_PACKAGE_ALSA_LIB_ALOAD=y
BR2_PACKAGE_ALSA_LIB_MIXER=y
BR2_PACKAGE_ALSA_LIB_PCM=y
BR2_PACKAGE_ALSA_LIB_RAWMIDI=y
BR2_PACKAGE_ALSA_LIB_HWDEP=y
BR2_PACKAGE_ALSA_LIB_SEQ=y
BR2_PACKAGE_ALSA_LIB_ALISP=y
BR2_PACKAGE_ALSA_LIB_OLD_SYMBOLS=y
BR2_PACKAGE_LIBSAMPLERATE=y
BR2_PACKAGE_ALSA_PLUGINS=y
BR2_PACKAGE_FFTW=y
BR2_PACKAGE_FFTW_FAST=y
BR2_PACKAGE_ALSA_UTILS=y
BR2_PACKAGE_ALSA_UTILS_ALSACTL=y
BR2_PACKAGE_ALSA_UTILS_ALSACONF=y
BR2_PACKAGE_ALSA_UTILS_AMIXER=y
BR2_PACKAGE_ALSA_UTILS_ALSAMIXER=y
BR2_PACKAGE_ALSA_UTILS_APLAY=y
BR2_PACKAGE_ALSA_UTILS_ALSALOOP=y
BR2_PACKAGE_ALSA_UTILS_ALSATPLG=y
BR2_PACKAGE_ALSA_UTILS_BAT=y
BR2_PACKAGE_ALSA_UTILS_IECSET=y
BR2_PACKAGE_ALSA_UTILS_SPEAKER_TEST=y
BR2_PACKAGE_LIBGLIB2=y


# adb5.config
BR2_PACKAGE_AML_USB_CONFIG=y
BR2_PACKAGE_ADB_RNDIS=y
BR2_PACKAGE_ANDROID_TOOLS5=y
BR2_PACKAGE_ANDROID_TOOLS5_ADBD=y
BR2_PACKAGE_ANDROID_TOOLS5_FASTBOOT_GOOD_KERNEL_HEADERS=y


# network_app.config
BR2_PACKAGE_DHCPCD=y
BR2_PACKAGE_DNSMASQ=y
BR2_PACKAGE_DNSMASQ_TFTP=y
BR2_PACKAGE_DNSMASQ_DHCP=y
BR2_PACKAGE_DNSMASQ_DNSSEC=y
BR2_PACKAGE_DNSMASQ_IDN=y
BR2_PACKAGE_DNSMASQ_CONNTRACK=y
BR2_PACKAGE_IW=y
BR2_PACKAGE_WPA_SUPPLICANT=y
BR2_PACKAGE_WPA_SUPPLICANT_CLI=y
BR2_PACKAGE_WPA_SUPPLICANT_WPA3=y
BR2_PACKAGE_WPA_SUPPLICANT_EAP=y
BR2_PACKAGE_HOSTAPD=y
BR2_PACKAGE_HOSTAPD_ACS=y
BR2_PACKAGE_HOSTAPD_EAP=y
BR2_PACKAGE_HOSTAPD_WPS=y
BR2_PACKAGE_NTP=y
BR2_PACKAGE_NTP_NTPD=y
BR2_PACKAGE_NTP_NTPDATE=y
BR2_PACKAGE_CA_CERTIFICATES=y
BR2_PACKAGE_OPENSSL=y
BR2_PACKAGE_OPENSSL_BIN=y
BR2_PACKAGE_OPENSSL_ENGINES=y
BR2_PACKAGE_DROPBEAR=y
BR2_PACKAGE_DROPBEAR_CLIENT=y
BR2_PACKAGE_DROPBEAR_SMALL=y


# swupdate.config
BR2_PACKAGE_SWUPDATE=y
BR2_PACKAGE_SWUPDATE_CONFIG="package/swupdate/swupdate.config"
# BR2_PACKAGE_SWUPDATE_INSTALL_WEBSITE=y
BR2_PACKAGE_LIBCURL=y
BR2_PACKAGE_LIBCURL_CURL=y


# flash_nand.config
BR2_TARGET_UBOOT_AMLOGIC_BOOTARGS="root=/dev/ubi0_0 rootfstype=ubifs init=/sbin/init"
BR2_TARGET_ROOTFS_UBI=y
BR2_TARGET_ROOTFS_UBIFS=y
BR2_TARGET_USBTOOL_UBI_AMLOGIC=y
BR2_PACKAGE_MTD=y
BR2_PACKAGE_MTD_FLASHCP=y
BR2_PACKAGE_MTD_FLASH_ERASE=y
BR2_PACKAGE_MTD_FLASH_LOCK=y
BR2_PACKAGE_MTD_FLASH_UNLOCK=y
BR2_PACKAGE_MTD_MKFSUBIFS=y
BR2_PACKAGE_MTD_MTDINFO=y
BR2_PACKAGE_MTD_MTD_DEBUG=y
BR2_PACKAGE_MTD_NANDDUMP=y
BR2_PACKAGE_MTD_NANDTEST=y
BR2_PACKAGE_MTD_NANDWRITE=y
BR2_PACKAGE_MTD_UBIATTACH=y
BR2_PACKAGE_MTD_UBIDETACH=y
BR2_PACKAGE_MTD_UBIFORMAT=y
BR2_PACKAGE_MTD_UBIMKVOL=y
BR2_PACKAGE_MTD_UBINFO=y
BR2_PACKAGE_MTD_UBIRSVOL=y
BR2_PACKAGE_MTD_UBINIZE=y


# flash_nand_4k.config
BR2_TARGET_ROOTFS_UBIFS_LEBSIZE=0x3e000
BR2_TARGET_ROOTFS_UBIFS_MAXLEBCNT=1120
BR2_TARGET_ROOTFS_UBIFS_OPTS="-F"
BR2_TARGET_ROOTFS_UBI_SUBSIZE=4096
BR2_TARGET_ROOTFS_UBIFS_MINIOSIZE=0x1000
BR2_TARGET_ROOTFS_UBI_PEBSIZE=0x40000



BR2_TARGET_ROOTFS_INITRAMFS_LIST="board/thirdreality/common/initramfs/ramfslist-64-ubi-release"

BR2_PACKAGE_PULSEAUDIO=y

BR2_PACKAGE_FFMPEG=y
BR2_PACKAGE_FFMPEG_SWSCALE=y
BR2_PACKAGE_FFMPEG_SWRESAMPLE=y
BR2_PACKAGE_FFMPEG_AVRESAMPLE=y
BR2_PACKAGE_FFMPEG_ENCODERS=y
BR2_PACKAGE_FFMPEG_DECODERS=y
BR2_PACKAGE_FFMPEG_MUXERS=y
BR2_PACKAGE_FFMPEG_DEMUXERS=y
BR2_PACKAGE_FFMPEG_PARSERS=y
BR2_PACKAGE_FFMPEG_FILTERS=y
BR2_PACKAGE_FFMPEG_PROTOCOLS=y
BR2_PACKAGE_MPV=y

BR2_PACKAGE_AMLOGIC_BOOT_FIP=y
BR2_PACKAGE_AMLOGIC_BOOT_FIP_BOARD="thirdreality-trspk"
BR2_PACKAGE_BROADCOM=y
BR2_PACKAGE_TR_PROJ_HA_SPEAKER=y

BR2_PACKAGE_DBUS=y
BR2_PACKAGE_TR_LEDRING=y
BR2_PACKAGE_FLEX=y
BR2_PACKAGE_AVAHI=y
BR2_PACKAGE_AVAHI_DAEMON=y

BR2_PACKAGE_JQ=y
BR2_PACKAGE_CJSON=y
BR2_PACKAGE_BLUEZ5_UTILS=y

BR2_PACKAGE_LINUX_VOICE_ASSISTANT_CPP=y
BR2_PACKAGE_TR_VOLUME=y
BR2_PACKAGE_TR_BUTTOND=y
BR2_STRIP_EXCLUDE_FILES="libtensorflowlite_c.so"
```

## buildroot/package/thirdreality/Config.in
```kconfig
menu "thirdreality"
    source "package/thirdreality/pyopen-wakeword/Config.in"
    source "package/thirdreality/pyring-buffer/Config.in"
    source "package/thirdreality/amlogic-boot-fip/Config.in"
    source "package/thirdreality/broadcom/Config.in"
    source "package/thirdreality/bluez5-utils/Config.in"
    source "package/thirdreality/snapcast/Config.in"
    source "package/thirdreality/sendspin-cpp/Config.in"
    source "package/thirdreality/linux-voice-assistant/Config.in"
    source "package/thirdreality/linux-voice-assistant-cpp/Config.in"
    source "package/thirdreality/python-soundcard/Config.in"
    source "package/thirdreality/python-mpv/Config.in"
    source "package/thirdreality/python-aioesphomeapi/Config.in"
    source "package/thirdreality/python-pymicro-wakeword/Config.in"
    source "package/thirdreality/python-pymicro-features/Config.in"
    source "package/thirdreality/python-noiseprotocol/Config.in"
    source "package/thirdreality/python-chacha20poly1305-reuseable/Config.in"
    source "package/thirdreality/python-aiohappyeyeballs/Config.in"
    source "package/thirdreality/python-async-interrupt/Config.in"
    source "package/thirdreality/python-tzlocal/Config.in"
    source "package/thirdreality/python-netifaces-2/Config.in"
    source "package/thirdreality/python-getmac/Config.in"
    source "package/thirdreality/python-webrtc-noise-gain/Config.in"

    source "package/thirdreality/tr-volume/Config.in"
    source "package/thirdreality/tr-buttond/Config.in"
    source "package/thirdreality/tr-ledring/Config.in"
    source "package/thirdreality/tr-proj-ha-speaker/Config.in"
endmenu
```

## buildroot/package/thirdreality/linux-voice-assistant-cpp/Config.in
```kconfig
config BR2_PACKAGE_LINUX_VOICE_ASSISTANT_CPP
	bool "linux-voice-assistant-cpp"
	depends on BR2_INSTALL_LIBSTDCPP
	depends on BR2_TOOLCHAIN_HAS_THREADS
	depends on BR2_PACKAGE_PROTOBUF_ARCH_SUPPORTS
	depends on BR2_TOOLCHAIN_GCC_AT_LEAST_4_9 # protobuf C++11 + json-for-modern-cpp
	depends on !BR2_STATIC_LIBS              # protobuf is shared-only
	select BR2_PACKAGE_PROTOBUF
	select BR2_PACKAGE_JSON_FOR_MODERN_CPP
	select BR2_PACKAGE_MPV
	select BR2_PACKAGE_PULSEAUDIO  # default audio output for libmpv
	select BR2_PACKAGE_TR_VOLUME
	select BR2_PACKAGE_WEBRTC_AUDIO_PROCESSING  # AGC + NS for the mic
	select BR2_PACKAGE_SENDSPIN_CPP  # in-process Sendspin player
	select BR2_PACKAGE_AVAHI
	select BR2_PACKAGE_AVAHI_DAEMON  # advertises _sendspin._tcp
	# Was selected by the removed sendspin-client package; ntpdate links
	# libdns_sd when it is present, so keep the image unchanged.
	select BR2_PACKAGE_AVAHI_LIBDNSSD_COMPATIBILITY
	default n
	help
	  Native ESPHome-API voice assistant for the ThirdReality
	  speaker. STT/TTS run in Home Assistant by default;
	  --voice-backend local runs them on-device. Also plays
	  Sendspin (Music Assistant) streams in process, behind the
	  same HA media player.

	  Requires gcc >= 10 (C++20). Do not enable together with
	  BR2_PACKAGE_LINUX_VOICE_ASSISTANT.
```

## buildroot/package/thirdreality/muse-gadget/Config.in
```kconfig
config BR2_PACKAGE_MUSE_GADGET
	bool "muse-gadget"
	depends on BR2_INSTALL_LIBSTDCPP
	depends on BR2_TOOLCHAIN_HAS_THREADS
	depends on BR2_USE_WCHAR
	depends on BR2_USE_MMU
	depends on !BR2_STATIC_LIBS
	depends on BR2_PACKAGE_PULSEAUDIO_HAS_ATOMIC
	select BR2_PACKAGE_ALSA_LIB
	select BR2_PACKAGE_OPENSSL
	select BR2_PACKAGE_LIBCURL
	select BR2_PACKAGE_PULSEAUDIO
	select BR2_PACKAGE_JSON_FOR_MODERN_CPP
	help
	  Muse community pairing and push-to-talk service for the
	  ThirdReality Voice & Music Assistant.
```

## buildroot/package/thirdreality/sendspin-cpp/Config.in
```kconfig
config BR2_PACKAGE_SENDSPIN_CPP
	bool
	depends on BR2_INSTALL_LIBSTDCPP
	depends on BR2_TOOLCHAIN_HAS_THREADS
	help
	  Sendspin synchronized audio streaming library (static,
	  staging only). Selected by linux-voice-assistant-cpp.

	  https://github.com/Sendspin/sendspin-cpp
```

## buildroot/package/thirdreality/tr-buttond/Config.in
```kconfig
config BR2_PACKAGE_TR_BUTTOND
	bool "tr-buttond"
	depends on BR2_INSTALL_LIBSTDCPP
	depends on BR2_TOOLCHAIN_HAS_THREADS
	depends on BR2_PACKAGE_PULSEAUDIO
	select BR2_PACKAGE_TR_VOLUME
	help
	  ThirdReality button daemon.

	  Owns /dev/input/event0 key dispatch (volume, mute, home, tap)
	  and replaces the policy role of Amlogic's input_eventd. Volume,
	  mute, factory-reset and wifi actions are delegated to
	  /etc/adckey/adckey_function.sh; tap/home semantic actions are
	  forwarded to linux-voice-assistant over a Unix datagram
	  socket. Runs independently so keys keep working when
	  those services are down.
```
